## arch/arm64/kvm/Kconfig
```kconfig
# SPDX-License-Identifier: GPL-2.0
#
# KVM configuration
#

source "virt/kvm/Kconfig"

menuconfig VIRTUALIZATION
	bool "Virtualization"
	help
	  Say Y here to get to see options for using your Linux host to run
	  other operating systems inside virtual machines (guests).
	  This option alone does not add any kernel code.

	  If you say N, all options in this submenu will be skipped and
	  disabled.

if VIRTUALIZATION

menuconfig KVM
	bool "Kernel-based Virtual Machine (KVM) support"
	depends on AS_HAS_ARMV8_4
	select KVM_COMMON
	select KVM_GENERIC_HARDWARE_ENABLING
	select KVM_GENERIC_MMU_NOTIFIER
	select HAVE_KVM_CPU_RELAX_INTERCEPT
	select KVM_MMIO
	select KVM_GENERIC_DIRTYLOG_READ_PROTECT
	select KVM_XFER_TO_GUEST_WORK
	select KVM_VFIO
	select HAVE_KVM_DIRTY_RING_ACQ_REL
	select NEED_KVM_DIRTY_RING_WITH_BITMAP
	select HAVE_KVM_MSI
	select HAVE_KVM_IRQCHIP
	select HAVE_KVM_IRQ_ROUTING
	select HAVE_KVM_IRQ_BYPASS
	select HAVE_KVM_READONLY_MEM
	select HAVE_KVM_VCPU_RUN_PID_CHANGE
	select SCHED_INFO
	select GUEST_PERF_EVENTS if PERF_EVENTS
	help
	  Support hosting virtualized guest machines.

	  If unsure, say N.

if KVM

config PTDUMP_STAGE2_DEBUGFS
	bool "Present the stage-2 pagetables to debugfs"
	depends on DEBUG_KERNEL
	depends on DEBUG_FS
	depends on GENERIC_PTDUMP
	select PTDUMP_CORE
	default n
	help
	  Say Y here if you want to show the stage-2 kernel pagetables
	  layout in a debugfs file. This information is only useful for kernel developers
	  who are working in architecture specific areas of the kernel.
	  It is probably not a good idea to enable this feature in a production
	  kernel.

	  If in doubt, say N.

config PKVM_MODULE_PATH
	string "Path to pKVM modules"
	default ""
	help
	  Directory where the pKVM modules are found. If empty, the modules
	  will be searched into the default path /lib/modules/<uname>.

menuconfig PKVM_DEBUG
	bool "Debug mode for Protected KVM hypervisor"
	help
	  Say Y here to enable the debug mode for the Protected KVM (pKVM)
	  hypervisor. Failure reports will BUG() in the hypervisor. This is
	  intended for local EL2 hypervisor development.

	  If unsure, say N.

if PKVM_DEBUG

config PKVM_STRICT_CHECKS
	bool "Additional checks in the Protected KVM hypervisor"
	default y
	help
	  Say Y here to add more checks into the Protected KVM hypervisor.
          Those checks have a slight performance cost and will BUG() on a
          failure. This is intended for EL2 hypervisor development.

config PKVM_SELFTESTS
	bool "Protected KVM hypervisor selftests"
	default y
	help
	  Say Y here to enable Protected KVM (pKVM) hypervisor selftests
	  during boot. Failure reports will panic the hypervisor. This is
	  intended for EL2 hypervisor development.

	  If unsure, say N.

config PKVM_DUMP_TRACE_ON_PANIC
	bool "Dump Protected KVM hypervisor trace buffer on panic"
	default y
	help
	   Say Y here to dump the content of the pKVM hypervisor on either
           hypervisor or host panic. In the case of a hyp panic, only the tail
           page is dumped. It only has an effect if the command line option
           hyp_trace_printk is set.

config PKVM_FTRACE
	bool "Protected KVM hypervisor function tracing"
	depends on FTRACE
	default y
	help
	  Say Y here to enable func and func_ret hypervisor tracing events.
	  Those events are raised whenever the hypervisor branch to a
	  function.

	  If unsure, Say N.

config PKVM_STACKTRACE
	bool "Protected KVM hypervisor stacktraces"
	depends on PKVM_DISABLE_STAGE2_ON_PANIC
	default y
	help
	  Say Y here to enable pKVM hypervisor stacktraces on hyp_panic()

	  If using protected nVHE mode, but cannot afford the associated
	  memory cost (less than 0.75 page per CPU) of pKVM stacktraces,
	  say N.

	  If unsure, or not using protected nVHE (pKVM), say N.

config PKVM_DISABLE_STAGE2_ON_PANIC
	bool "Disable the host stage-2 on panic"
	default n
	help
	  If panic occurs while the host lock is held and if, plagued by bad
	  luck the panic path triggers a host stage-2 memory abort, a lockup
	  would happen. The only way out is to disable the stage-2 page-table.
	  This however tamper the system security. This option should therefore
	  solely be enabled to debug specific issues.

	  Just say N.

endif # PKVM_DEBUG
endif # KVM
endif # VIRTUALIZATION
```

## arch/x86/kvm/Kconfig
```kconfig
# SPDX-License-Identifier: GPL-2.0
#
# KVM configuration
#

source "virt/kvm/Kconfig"

menuconfig VIRTUALIZATION
	bool "Virtualization"
	depends on HAVE_KVM || X86
	default y
	help
	  Say Y here to get to see options for using your Linux host to run other
	  operating systems inside virtual machines (guests).
	  This option alone does not add any kernel code.

	  If you say N, all options in this submenu will be skipped and disabled.

if VIRTUALIZATION

config KVM
	tristate "Kernel-based Virtual Machine (KVM) support"
	depends on HAVE_KVM
	depends on HIGH_RES_TIMERS
	depends on X86_LOCAL_APIC
	select PREEMPT_NOTIFIERS
	select MMU_NOTIFIER
	select HAVE_KVM_IRQCHIP
	select HAVE_KVM_PFNCACHE
	select HAVE_KVM_IRQFD
	select HAVE_KVM_DIRTY_RING_TSO
	select HAVE_KVM_DIRTY_RING_ACQ_REL
	select IRQ_BYPASS_MANAGER
	select HAVE_KVM_IRQ_BYPASS
	select HAVE_KVM_IRQ_ROUTING
	select HAVE_KVM_EVENTFD
	select KVM_ASYNC_PF
	select USER_RETURN_NOTIFIER
	select KVM_MMIO
	select SCHED_INFO
	select PERF_EVENTS
	select GUEST_PERF_EVENTS
	select HAVE_KVM_MSI
	select HAVE_KVM_CPU_RELAX_INTERCEPT
	select HAVE_KVM_NO_POLL
	select KVM_XFER_TO_GUEST_WORK
	select KVM_GENERIC_DIRTYLOG_READ_PROTECT
	select KVM_VFIO
	select INTERVAL_TREE
	select HAVE_KVM_PM_NOTIFIER if PM
	select KVM_GENERIC_HARDWARE_ENABLING
	select HAVE_KVM_VCPU_RUN_PID_CHANGE
	help
	  Support hosting fully virtualized guest machines using hardware
	  virtualization extensions.  You will need a fairly recent
	  processor equipped with virtualization extensions. You will also
	  need to select one or more of the processor modules below.

	  This module provides access to the hardware capabilities through
	  a character device node named /dev/kvm.

	  To compile this as a module, choose M here: the module
	  will be called kvm.

	  If unsure, say N.

config KVM_WERROR
	bool "Compile KVM with -Werror"
	# KASAN may cause the build to fail due to larger frames
	default y if X86_64 && !KASAN
	# We use the dependency on !COMPILE_TEST to not be enabled
	# blindly in allmodconfig or allyesconfig configurations
	depends on KVM
	depends on (X86_64 && !KASAN) || !COMPILE_TEST
	depends on EXPERT
	help
	  Add -Werror to the build flags for KVM.

	  If in doubt, say "N".

config KVM_INTEL
	tristate "KVM for Intel (and compatible) processors support"
	depends on KVM && IA32_FEAT_CTL
	help
	  Provides support for KVM on processors equipped with Intel's VT
	  extensions, a.k.a. Virtual Machine Extensions (VMX).

	  To compile this as a module, choose M here: the module
	  will be called kvm-intel.

config PKVM_INTEL
	bool "pKVM for Intel processors support"
	depends on KVM_INTEL=y
	depends on X86_64
	depends on !KSM
	depends on INTEL_IOMMU
	select INTEL_IOMMU_DEFAULT_ON
	select INTEL_IOMMU_SCALABLE_MODE_DEFAULT_ON
	help
	  Provides support for pKVM on Intel processors.

	  This will deprivilege the host as a VM running in non-root VMX
	  operation mode, and pKVM hypervisor will run in root VMX
	  operation mode.

	  If unsure, say N.

config PKVM_INTEL_DEBUG
        bool "Debug pKVM"
        depends on PKVM_INTEL
        help
          Provides debug support for pKVM.

          If unsure, say N.

config X86_SGX_KVM
	bool "Software Guard eXtensions (SGX) Virtualization"
	depends on X86_SGX && KVM_INTEL
	help

	  Enables KVM guests to create SGX enclaves.

	  This includes support to expose "raw" unreclaimable enclave memory to
	  guests via a device node, e.g. /dev/sgx_vepc.

	  If unsure, say N.

config KVM_AMD
	tristate "KVM for AMD processors support"
	depends on KVM && (CPU_SUP_AMD || CPU_SUP_HYGON)
	help
	  Provides support for KVM on AMD processors equipped with the AMD-V
	  (SVM) extensions.

	  To compile this as a module, choose M here: the module
	  will be called kvm-amd.

config KVM_AMD_SEV
	def_bool y
	bool "AMD Secure Encrypted Virtualization (SEV) support"
	depends on KVM_AMD && X86_64
	depends on CRYPTO_DEV_SP_PSP && !(KVM_AMD=y && CRYPTO_DEV_CCP_DD=m)
	help
	  Provides support for launching Encrypted VMs (SEV) and Encrypted VMs
	  with Encrypted State (SEV-ES) on AMD processors.

config KVM_SMM
	bool "System Management Mode emulation"
	default y
	depends on KVM
	help
	  Provides support for KVM to emulate System Management Mode (SMM)
	  in virtual machines.  This can be used by the virtual machine
	  firmware to implement UEFI secure boot.

	  If unsure, say Y.

config KVM_XEN
	bool "Support for Xen hypercall interface"
	depends on KVM
	help
	  Provides KVM support for the hosting Xen HVM guests and
	  passing Xen hypercalls to userspace.

	  If in doubt, say "N".

config KVM_PROVE_MMU
	bool "Prove KVM MMU correctness"
	depends on DEBUG_KERNEL
	depends on KVM
	depends on EXPERT
	help
	  Enables runtime assertions in KVM's MMU that are too costly to enable
	  in anything remotely resembling a production environment, e.g. this
	  gates code that verifies a to-be-freed page table doesn't have any
	  present SPTEs.

	  If in doubt, say "N".

config KVM_EXTERNAL_WRITE_TRACKING
	bool

config KVM_VIRT_SUSPEND_TIMING
	bool "Host support for virtual suspend time injection"
	depends on KVM=y && HAVE_KVM_PM_NOTIFIER
	default n
	help
	 This option makes the host's suspension reflected on the guest's clocks.
	 In other words, guest's CLOCK_MONOTONIC will stop and
	 CLOCK_BOOTTIME keeps running during the host's suspension.
	 This feature will only be effective when both guest and host support
	 this feature. For the guest side, see KVM_VIRT_SUSPEND_TIMING_GUEST.

	 If unsure, say N.

config PARAVIRT_SCHED_KVM
	bool "Enable paravirt scheduling capability for kvm"
	depends on KVM
	default n
	help
	  Paravirtualized scheduling facilitates the exchange of scheduling
	  related information between the host and guest through shared memory,
	  enhancing the efficiency of vCPU thread scheduling by the hypervisor.
	  An illustrative use case involves dynamically boosting the priority of
	  a vCPU thread when the guest is executing a latency-sensitive workload
	  on that specific vCPU.
	  This config enables paravirt scheduling in the kvm hypervisor.

endif # VIRTUALIZATION
```

## drivers/android/binder/Kconfig
```kconfig
# SPDX-License-Identifier: GPL-2.0

config ANDROID_BINDER_IPC_RUST
	tristate "Rust version of Android Binder IPC Driver"
	depends on RUST && ANDROID_BINDER_IPC && ANDROID_BINDERFS
	help
	  This enables the Rust implementation of the Binder driver. At this
	  time, the Rust implementation can only be built as an alternative to
	  the C implementation. By default, the C implementation is used, but
	  if the binder.impl=rust kernel command-line parameter is provided,
	  then the Rust implementation is used instead.

	  To build this as a GKI module, choose m.

config ANDROID_BINDER_IPC_RUST_DUMMY
	tristate "Empty module called rust_binder.ko"
	depends on ANDROID_BINDER_IPC && !ANDROID_BINDER_IPC_RUST
	help
	  This creates an empty module of the same name as the Rust Binder
	  module. This option can be used to trick the build system into
	  thinking that Rust Binder was successfully built in cases where Rust
	  support is unavailable.
```

## drivers/cma/mm/Kconfig
```kconfig
#
# Configs for the Memory drivers
#
config MEM_PHYSICAL_LAYOUT
       tristate "Driver to print the physical memory layout"
       default y
       help
         Driver to print the physical memory layout
```

## drivers/staging/android/Kconfig
```kconfig
# SPDX-License-Identifier: GPL-2.0
menu "Android"

config ANDROID_STAGING
	bool

config ASHMEM
	bool "Enable the Anonymous Shared Memory Subsystem"
	depends on SHMEM
	select ANDROID_STAGING
	help
	  The ashmem subsystem is a new shared memory allocator, similar to
	  POSIX SHM but with different behavior and sporting a simpler
	  file-based API.

	  It is, in theory, a good memory allocator for low-memory devices,
	  because it can discard shared memory units when under memory pressure.

config ASHMEM_RUST
	bool "Use the Rust implementation of Ashmem"
	depends on ASHMEM && RUST

config ASHMEM_C
	def_bool ASHMEM && !ASHMEM_RUST

endmenu
```

## drivers/virt/coco/gunyah-guest/Kconfig
```kconfig
config GUNYAH_GUEST
	bool "Gunyah protected guest driver"
	depends on ARM64
	select ARCH_HAS_MEM_RELINQUISH
	select GUNYAH_HYPERCALLS
	help
	  Protected guests running under the Gunyah hypervisor
	  are isolated from the host and must issue hypercalls to enable
	  interaction with virtual devices. This driver implements
	  support for probing and issuing these hypercalls.

	  If unsure, say 'N'.
```
