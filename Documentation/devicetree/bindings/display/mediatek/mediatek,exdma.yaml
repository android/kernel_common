## Documentation/devicetree/bindings/display/mediatek/mediatek,exdma.yaml
```yaml
# SPDX-License-Identifier: (GPL-2.0-only OR BSD-2-Clause)
%YAML 1.2
---
$id: http://devicetree.org/schemas/display/mediatek/mediatek,exdma.yaml#
$schema: http://devicetree.org/meta-schemas/core.yaml#

title: MediaTek EXDMA

maintainers:
  - Chun-Kuang Hu <chunkuang.hu@kernel.org>
  - Philipp Zabel <p.zabel@pengutronix.de>

description:
  The MediaTek display overlap extended DMA engine, namely OVL_EXDMA or EXDMA,
  primarily functions as a DMA engine for reading data from DRAM with various
  DRAM footprints and data formats. For input sources in certain color formats
  and color domains, OVL_EXDMA also includes a color transfer function
  to process pixels into a consistent color domain.

properties:
  compatible:
    const: mediatek,mt8196-exdma

  reg:
    maxItems: 1

  clocks:
    items:
      - description: EXDMA Clock

  power-domains:
    maxItems: 1

  mediatek,larb:
    $ref: /schemas/types.yaml#/definitions/phandle
    description: |
      A phandle to the local arbiters node in the current SoCs.
      Refer to bindings/memory-controllers/mediatek,smi-larb.yaml.

  iommus:
    maxItems: 1

  '#dma-cells':
    const: 1

required:
  - compatible
  - reg
  - clocks
  - power-domains
  - mediatek,larb
  - iommus

additionalProperties: false

examples:
  - |
    #include <dt-bindings/clock/mt8196-clk.h>
    #include <dt-bindings/power/mt8196-power.h>

    soc {
        #address-cells = <2>;
        #size-cells = <2>;

        disp_ovl0_exdma2: dma-controller@32850000 {
            compatible = "mediatek,mt8196-exdma";
            reg = <0 0x32850000 0 0x1000>;
            clocks = <&ovlsys_config_clk CLK_OVL_EXDMA2_DISP>;
            power-domains = <&hfrpsys MT8196_POWER_DOMAIN_OVL0_DORMANT>;
            mediatek,larb = <&smi_larb0>;
            iommus = <&mm_smmu 144>;
            #dma-cells = <1>;
        };
    };
```

## Documentation/devicetree/bindings/display/mediatek/mediatek,outproc.yaml
```yaml
# SPDX-License-Identifier: (GPL-2.0-only OR BSD-2-Clause)
%YAML 1.2
---
$id: http://devicetree.org/schemas/display/mediatek/mediatek,outproc.yaml#
$schema: http://devicetree.org/meta-schemas/core.yaml#

title: MediaTek display overlap output processor

maintainers:
  - Chun-Kuang Hu <chunkuang.hu@kernel.org>
  - Philipp Zabel <p.zabel@pengutronix.de>

description: |
  MediaTek display overlap output processor, namely OVL_OUTPROC or OUTPROC,
  handles the post-stage of pixel processing in the overlapping procedure.
  OVL_OUTPROC manages pixels for gamma correction and ensures that pixel
  values are within the correct range.

properties:
  compatible:
    const: mediatek,mt8196-outproc

  reg:
    maxItems: 1

  clocks:
    items:
      - description: Overlap Output Processor Clock

  interrupts:
    maxItems: 1

required:
  - compatible
  - reg
  - clocks
  - interrupts

additionalProperties: false

examples:
  - |
    #include <dt-bindings/clock/mt8196-clk.h>
    #include <dt-bindings/interrupt-controller/arm-gic.h>
    #include <dt-bindings/interrupt-controller/irq.h>

    soc {
        #address-cells = <2>;
        #size-cells = <2>;

        disp_ovl0_outproc0: outproc@32970000 {
            compatible = "mediatek,mt8196-outproc";
            reg = <0 0x32970000 0 0x1000>;
            clocks = <&ovlsys_config_clk CLK_OVL_OUTPROC0_DISP>;
            interrupts = <GIC_SPI 450 IRQ_TYPE_LEVEL_HIGH 0>;
        };
    };
```

## Documentation/devicetree/bindings/firmware/gunyah-cma-mem.yaml
```yaml
# SPDX-License-Identifier: (GPL-2.0-only OR BSD-2-Clause)
%YAML 1.2
---
$id: http://devicetree.org/schemas/firmware/gunyah-cma-mem.yaml#
$schema: http://devicetree.org/meta-schemas/core.yaml#

title: Contiguous memory allocator for Virtual Machines

maintainers:
  - Prakruthi Deepak Heragu <quic_pheragu@quicinc.com>
  - Elliot Berman <quic_eberman@quicinc.com>

description: |+
  gunyah-cma-mem is a CMA memory manager that allows VMMs to use
  contiguous memory to backup Virtual Machines running on Gunyah. These
  regions are pre-defined by the firmware to have special attributes
  like memory encryption.

properties:
  compatible:
      - const: gunyah-cma-vm-mem

  memory-region:
    $ref: '/schemas/types.yaml#/definitions/phandle'
    items:
      - description: |
          Describes the specific reserved memory region that this allocator
          will allocate memory from for a Virtual Machine. Refer to
          Documentation/devicetree/bindings/reserved-memory/reserved-memory.txt
          for more information.

  memory-region-names:
    $ref: /schemas/types.yaml#/definitions/string-array
    items:
      - description: Name of the memory-region to be used by VMM for operation

required:
  - compatible
  - memory-region
  - memory-region-names

example:
  - |
    gunyah-cma-mem {
	compatible = "gunyah-cma-vm-mem";
	memory-region = <&trust_ui_vm_mem &oem_vm_mem>;
	memory-region-names = "trustedvm_cma" , "oemvm_cma";
    };
```

## Documentation/devicetree/bindings/input/touchscreen/himax,hx83102j.yaml
```yaml
# SPDX-License-Identifier: (GPL-2.0-only OR BSD-2-Clause)
%YAML 1.2
---
$id: http://devicetree.org/schemas/input/touchscreen/himax,hx83102j.yaml#
$schema: http://devicetree.org/meta-schemas/core.yaml#

title: Himax hx83102j touchscreen

maintainers:
  - Allen Lin <allencl_lin@hotmail.com>

description:
  This Himax hx83102j touchscreen uses the spi protocol.

allOf:
  - $ref: /schemas/input/touchscreen/touchscreen.yaml#
  - $ref: /schemas/spi/spi-peripheral-props.yaml#

properties:
  compatible:
    const: himax,hx83102j

  reg:
    maxItems: 1

  interrupts:
    maxItems: 1

  reset-gpios:
    maxItems: 1

  vccd-supply:
    description: A phandle for the regulator supplying IO power.

  vsn-supply:
    description: Negative supply regulator.

  vsp-supply:
    description: Positive supply regulator.

  ddreset-gpios:
    description: A phandle of gpio for display reset controlled by the LCD driver.
      This is the master reset, if this reset is triggered, the TP reset will
      also be triggered.

  spi-cpha: true

  spi-cpol: true

  spi-max-frequency: true

  panel: true

  firmware-name:
    description: Specify the file name for firmware loading.

required:
  - compatible
  - reg
  - interrupts
  - reset-gpios
  - panel
  - vccd-supply
  - vsn-supply
  - vsp-supply
  - ddreset-gpios

additionalProperties: false

examples:
  - |
    #include <dt-bindings/gpio/gpio.h>
    #include <dt-bindings/interrupt-controller/irq.h>
    spi {
      #address-cells = <1>;
      #size-cells = <0>;
      ap_ts: touchscreen@0 {
        compatible = "himax,hx83102j";
        reg = <0>;
        pinctrl-names = "default";
        pinctrl-0 = <&touch_int0 &touch_reset>;
        reset-gpios = <&gpio1 8 GPIO_ACTIVE_LOW>;
        spi-cpha;
        spi-cpol;
        interrupt-parent = <&gpio1>;
        interrupts = <7 IRQ_TYPE_LEVEL_LOW>;
        panel = <&panel>;
        vccd-supply = <&regulator>;
        vsn-supply = <&regulator>;
        vsp-supply = <&regulator>;
        ddreset-gpios = <&gpio1>;
      };
    };
```

## Documentation/devicetree/bindings/iommu/pkvm,pviommu.yaml
```yaml
# SPDX-License-Identifier: GPL-2.0-only
%YAML 1.2
---
title: pKVM pvIOMMU

maintainers:
  - Mostafa Saleh <smostafa@google.org>

description: |+
  pvIOMMU is a paravirtual IOMMU implemented through arm64 hypercalls (HVC).
  What distinguishes it from other paravirtual IOMMUs (virtio-iommu)
  is that it has very simple transport which makes it easy for
  hypervisors with a small TCB as in confidential computing to implement
  it without complexity and with lower performance overhead.
  pvIOMMU was initially developed for protected KVM (pKVM), but it has no
  KVM specific interface, so it can be implemented by other hypervisors
  also.

properties:
  $nodename:
    pattern: "^iommu@[0-9a-f]*"
  compatible:
    const: pkvm,pviommu

  id:
    maxItems: 1

  '#iommu-cells':
    const: 1

required:
  - compatible
  - id
  - '#iommu-cells'

additionalProperties: false

examples:
  - |+
    iommu@55 {
            compatible = "pkvm,pviommu";
            id = <0x55>;
            #iommu-cells = <1>;
    };
```

## Documentation/devicetree/bindings/mailbox/mediatek,apu-mailbox.yaml
```yaml
# SPDX-License-Identifier: (GPL-2.0-only OR BSD-2-Clause)
%YAML 1.2
---
$id: http://devicetree.org/schemas/mailbox/mediatek,apu-mailbox.yaml#
$schema: http://devicetree.org/meta-schemas/core.yaml#

title: MediaTek APU mailbox

maintainers:
  - Karl Li <Karl.Li@mediatek.com>

description:
  MediaTek APU (AI Processing Unit) is a microcontroller unit
  designed for AI acceleration tasks. The MediaTek APU-Mailbox
  facilitates communication with the APU microcontroller.
  Within the MediaTek APU subsystem, a message passing mechanism is
  built on top of the mailbox system. The mailbox only has limited
  space for each message. The firmware expects the message header
  from the mailbox, while the message body is passed through some
  fixed shared memory.

properties:
  compatible:
    const: mediatek,mt8196-apu-mailbox

  "#mbox-cells":
    const: 1
    description:
      The cell describe which channel the device will use.

  reg:
    maxItems: 1

  interrupts:
    maxItems: 1

required:
  - compatible
  - "#mbox-cells"
  - reg
  - interrupts

additionalProperties: false

examples:
  - |
    #include <dt-bindings/interrupt-controller/arm-gic.h>
    #include <dt-bindings/interrupt-controller/irq.h>

    soc {
      #address-cells = <2>;
      #size-cells = <2>;

      mailbox@4c200000 {
        compatible = "mediatek,mt8196-apu-mailbox";
        reg = <0 0x4c200000 0 0xfffff>;
        interrupts = <GIC_SPI 638 IRQ_TYPE_LEVEL_HIGH 0>;
        #mbox-cells = <1>;
      };
    };
```
