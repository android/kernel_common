// SPDX-License-Identifier: (GPL-2.0 OR MIT)
/*
 * Copyright 2024 Google LLC
 */

/dts-v1/;
#include "mt8186-corsola-veluza.dtsi"

/ {
	model = "Google veluza sku65536/65537/65538/65539/65540/65541/65542/
		65543/65544/65545/65546 board";
	compatible = "google,veluza-sku65536", "google,veluza-sku65537",
		     "google,veluza-sku65538", "google,veluza-sku65539",
		     "google,veluza-sku65540", "google,veluza-sku65541",
		     "google,veluza-sku65542", "google,veluza-sku65543",
		     "google,veluza-sku65544", "google,veluza-sku65545",
		     "google,veluza-sku65546", "google,veluza",
		     "google,corsola", "mediatek,mt8186";
};

&gpio_keys {
	status = "disabled";
};
