// SPDX-License-Identifier: (GPL-2.0 OR MIT)
/*
 * Copyright 2023 Google LLC
 */
/dts-v1/;
#include "mt8188-geralt-ciri.dtsi"

/ {
	model = "Google Ciri sku0 board";
	compatible = "google,ciri-sku0", "google,ciri", "mediatek,mt8188";
};
